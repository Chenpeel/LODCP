## firmware/sdkconfig.defaults
```kconfig
# ESP32-CAM 特定配置
CONFIG_ESP32_SPIRAM_SUPPORT=y
CONFIG_ESPTOOLPY_FLASHSIZE_4MB=y
CONFIG_CAMERA_SUPPORT=y
CONFIG_CAMERA_MODEL_AI_THINKER=y

# WiFi 配置
CONFIG_ESP32_WIFI_STATIC_RX_BUFFER_NUM=16
CONFIG_ESP32_WIFI_DYNAMIC_RX_BUFFER_NUM=32
CONFIG_ESP32_WIFI_DYNAMIC_TX_BUFFER_NUM=32

# 内存相关配置
CONFIG_ESP_MAIN_TASK_STACK_SIZE=8192
CONFIG_SPIRAM_USE=y
CONFIG_SPIRAM_SPEED_80M=y
CONFIG_SPIRAM_MEMTEST=y
CONFIG_SPIRAM_CACHE_WORKAROUND=y

# TensorFlow Lite 相关配置
CONFIG_OPTIMIZATION_LEVEL_RELEASE=y
CONFIG_COMPILER_OPTIMIZATION_LEVEL_RELEASE=y

# 日志级别
CONFIG_LOG_DEFAULT_LEVEL_INFO=y

# 分区表配置
CONFIG_PARTITION_TABLE_CUSTOM=y
CONFIG_PARTITION_TABLE_CUSTOM_FILENAME="partitions.csv"

CONFIG_SDMMC_HOST_ENABLED=y
CONFIG_SDMMC_USE_GPIO_MATRIX=y
CONFIG_SDMMC_FREQ_DEFAULT=40000000
CONFIG_SDMMC_WIDTH_4_ENABLED=y
CONFIG_SDMMC_CACHE_ENABLED=y
CONFIG_FATFS_LFN_HEAP=y
CONFIG_FATFS_MAX_LFN=255
CONFIG_FATFS_API_ENCODING_UTF_8=y
CONFIG_FATFS_USE_FASTSEEK=y

# 增加应用程序堆栈大小，处理模型加载
CONFIG_ESP_MAIN_TASK_STACK_SIZE=16384
CONFIG_SPIRAM_FETCH_INSTRUCTIONS=y
CONFIG_SPIRAM_RODATA=y
EOF
```
